## config/boards/shields/sg2/Kconfig.defconfig
```kconfig
if SHIELD_SG3_LEFT

# Name must be less than 16 characters long!
config ZMK_KEYBOARD_NAME
    default "sg3"

config ZMK_SPLIT_ROLE_CENTRAL
    default y

endif

if SHIELD_SG3_LEFT || SHIELD_SG3_RIGHT

config ZMK_SPLIT
    default y

endif
```

## config/boards/shields/sg2/Kconfig.shield
```kconfig
config SHIELD_SG3_LEFT
    def_bool $(shields_list_contains,sg3_left)

config SHIELD_SG3_RIGHT
    def_bool $(shields_list_contains,sg3_right)
```
